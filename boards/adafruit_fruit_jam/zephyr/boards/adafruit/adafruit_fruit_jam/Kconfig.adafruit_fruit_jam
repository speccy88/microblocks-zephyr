## boards/adafruit_fruit_jam/zephyr/boards/adafruit/adafruit_fruit_jam/Kconfig.adafruit_fruit_jam
```kconfig
# SPDX-License-Identifier: Apache-2.0
config BOARD_ADAFRUIT_FRUIT_JAM
	select SOC_RP2350B_M33_0 if BOARD_ADAFRUIT_FRUIT_JAM_RP2350B_M33_0
```

## boards/adafruit_fruit_jam/zephyr/boards/adafruit/adafruit_fruit_jam/Kconfig.defconfig
```kconfig
# SPDX-License-Identifier: Apache-2.0
if BOARD_ADAFRUIT_FRUIT_JAM
config USB_SELF_POWERED
	default n
endif
```

## boards/adafruit_fruit_jam/zephyr/boards/adafruit/adafruit_fruit_jam/adafruit_fruit_jam_rp2350b_m33_0_defconfig
```kconfig
# SPDX-License-Identifier: Apache-2.0
CONFIG_BUILD_OUTPUT_HEX=y
CONFIG_BUILD_OUTPUT_UF2=y
CONFIG_BUILD_OUTPUT_UF2_FAMILY_ID="0xe48bff59"
CONFIG_CLOCK_CONTROL=y
CONFIG_GPIO=y
CONFIG_RESET=y
CONFIG_SERIAL=y
CONFIG_UART_INTERRUPT_DRIVEN=y
CONFIG_USE_DT_CODE_PARTITION=y
```

## boards/adafruit_fruit_jam/zephyr/boards/adafruit/adafruit_fruit_jam/board.yml
```yaml
board:
  name: adafruit_fruit_jam
  full_name: Adafruit Fruit Jam (experimental MicroBlocks port)
  vendor: adafruit
  socs:
  - name: rp2350b
```

## boards/sparkfun_xrp_rp2350/zephyr/boards/sparkfun/sparkfun_xrp/board.yml
```yaml
board:
  name: sparkfun_xrp
  full_name: SparkFun XRP RP2350 production (experimental MicroBlocks port)
  vendor: sparkfun
  socs:
    - name: rp2350b
```
