## CMakeLists.txt
```
# SPDX-License-Identifier: MIT
cmake_minimum_required(VERSION 3.28.0)
list(APPEND BOARD_ROOT "${CMAKE_CURRENT_SOURCE_DIR}/../zephyr")
find_package(Zephyr REQUIRED HINTS $ENV{ZEPHYR_BASE})
project(xrp_production_non_actuating LANGUAGES C ASM)
execute_process(COMMAND git -C ${ZEPHYR_BASE} rev-parse HEAD
  OUTPUT_VARIABLE xrp_zephyr_commit OUTPUT_STRIP_TRAILING_WHITESPACE
  COMMAND_ERROR_IS_FATAL ANY)
if(NOT xrp_zephyr_commit STREQUAL "a915b2f12675b48b16d56653ea145dcd8f20cbbf")
  message(FATAL_ERROR "Use the XRP target's pinned Zephyr revision")
endif()
if(NOT CONFIG_BOARD_SPARKFUN_XRP_RP2350B_M33_0)
  message(FATAL_ERROR "This app is restricted to sparkfun_xrp/rp2350b/m33_0, not beta or another RP2350")
endif()
if(CONFIG_WIFI OR CONFIG_BT OR CONFIG_FLASH OR CONFIG_PWM)
  message(FATAL_ERROR "This non-actuating baseline does not enable radio, flash writes or PWM")
endif()
target_sources(app PRIVATE src/main.c)
```

## prj.conf
```kconfig
CONFIG_GPIO=y
CONFIG_I2C=y
CONFIG_SERIAL=y
CONFIG_UART_INTERRUPT_DRIVEN=y
CONFIG_UART_LINE_CTRL=y
CONFIG_USB_DEVICE_STACK_NEXT=y
CONFIG_CDC_ACM_SERIAL_INITIALIZE_AT_BOOT=y
CONFIG_CDC_ACM_SERIAL_PID=0x0004
CONFIG_CDC_ACM_SERIAL_PRODUCT_STRING="XRP RP2350 non-actuating baseline"
CONFIG_CONSOLE=n
CONFIG_UART_CONSOLE=n
CONFIG_PRINTK=n
CONFIG_LOG=n
CONFIG_SHELL=n
CONFIG_BOOT_BANNER=n
CONFIG_WIFI=n
CONFIG_BT=n
CONFIG_FLASH=n
CONFIG_PWM=n
CONFIG_MAIN_STACK_SIZE=4096
```

## app.overlay
```dts
/* SPDX-License-Identifier: MIT */
&zephyr_udc0 {
    xrp_cdc: xrp_cdc { compatible = "zephyr,cdc-acm-uart"; };
};
```

## src/main.c
```c
/* SPDX-License-Identifier: MIT
 * Production XRP only. Quiet, non-actuating source-stage diagnostic.
 * No motor PWM, servo pulses, LEDs, ultrasonic trigger, radio or flash writes. */
#include <zephyr/device.h>
#include <zephyr/drivers/gpio.h>
#include <zephyr/drivers/i2c.h>
#include <zephyr/kernel.h>
#include <errno.h>

#define USER DT_PATH(zephyr_user)
#define MOTOR(index) GPIO_DT_SPEC_GET_BY_IDX(USER, motor_input_gpios, index)
static const struct gpio_dt_spec motor_inputs[] = {
    MOTOR(0), MOTOR(1), MOTOR(2), MOTOR(3), MOTOR(4), MOTOR(5), MOTOR(6), MOTOR(7)
};
static const struct gpio_dt_spec button = GPIO_DT_SPEC_GET(USER, user_button_gpios);
static const struct device *const imu_bus = DEVICE_DT_GET(DT_NODELABEL(i2c1));
/* Debugger-visible evidence only; not a claim that the physical checks passed. */
volatile struct {
    uint32_t signature, motor_coast_failures, cycles;
    int button_error, button_pressed, imu_error;
    uint8_t imu_family_id;
    bool actuator_commands_enabled;
} xrp_baseline_status = {.signature = 0x58525032, .actuator_commands_enabled = false};

int main(void)
{
    for (unsigned i = 0; i < ARRAY_SIZE(motor_inputs); ++i) {
        int error = !gpio_is_ready_dt(&motor_inputs[i]) ? -ENODEV :
            gpio_pin_configure_dt(&motor_inputs[i], GPIO_OUTPUT_INACTIVE);
        if (error) xrp_baseline_status.motor_coast_failures |= 1u << i;
    }
    xrp_baseline_status.button_error = !gpio_is_ready_dt(&button) ? -ENODEV :
        gpio_pin_configure_dt(&button, GPIO_INPUT | GPIO_PULL_UP);
    uint8_t identity = 0;
    xrp_baseline_status.imu_error = !device_is_ready(imu_bus) ? -ENODEV :
        i2c_reg_read_byte(imu_bus, 0x6b, 0x0f, &identity);
    if (!xrp_baseline_status.imu_error) xrp_baseline_status.imu_family_id = identity;
    for (;;) {
        if (!xrp_baseline_status.button_error)
            xrp_baseline_status.button_pressed = gpio_pin_get_dt(&button);
        ++xrp_baseline_status.cycles;
        k_msleep(1000);
    }
    return 0;
}
```
