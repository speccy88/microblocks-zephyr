## CMakeLists.txt
```
# SPDX-License-Identifier: MIT
cmake_minimum_required(VERSION 3.28.0)
find_package(Zephyr REQUIRED HINTS $ENV{ZEPHYR_BASE})
project(waveshare_smallvm LANGUAGES C CXX)
if(NOT SMALLVM_SOURCE_DIR OR NOT EXISTS "${SMALLVM_SOURCE_DIR}/provenance.json")
  message(FATAL_ERROR "Set SMALLVM_SOURCE_DIR to the verified v417 snapshot")
endif()
set(vm_root "${CMAKE_CURRENT_BINARY_DIR}/smallvm")
execute_process(COMMAND ${Python3_EXECUTABLE}
  ${CMAKE_CURRENT_SOURCE_DIR}/../../../tools/prepare_smallvm.py
  ${SMALLVM_SOURCE_DIR} ${vm_root}
  COMMAND_ERROR_IS_FATAL ANY)
target_include_directories(app PRIVATE ${vm_root} ${vm_root}/vm ../bringup/src src)
target_compile_definitions(app PRIVATE SMALLVM_ZEPHYR=1)
target_sources(app PRIVATE src/main.cpp src/platform.c src/arduino_transport.cpp
  src/generic_primitives.c src/generic_io.cpp
  ../bringup/src/rlcd_board.c ../bringup/src/rlcd_audio.c ../integration/rlcd_smallvm_primitives.c
  ${vm_root}/vm/interp.c ${vm_root}/vm/runtime.c ${vm_root}/vm/mem.c
  ${vm_root}/vm/persist.c ${vm_root}/vm/dataPrims.c ${vm_root}/vm/varPrims.c
  ${vm_root}/vm/tinyJSON.c ${vm_root}/vm/mbFont.c ${vm_root}/vm/boardHooks.c)
```

## prj.conf
```kconfig
CONFIG_ARDUINO_API=y
CONFIG_ARDUINO_ENTRY=n
CONFIG_ARDUINO_API_SERIAL_BUFFER_SIZE=4096
CONFIG_CPP=y
CONFIG_GPIO=y
CONFIG_I2C=y
CONFIG_SPI=y
CONFIG_SENSOR=y
CONFIG_RTC=y
CONFIG_ADC=y
CONFIG_PWM=y
CONFIG_DISPLAY=y
CONFIG_INPUT=y
CONFIG_MAIN_STACK_SIZE=8192
CONFIG_HEAP_MEM_POOL_SIZE=16384
# SmallVM owns USB Serial/JTAG binary transport exclusively.
CONFIG_CONSOLE=n
CONFIG_UART_CONSOLE=n
CONFIG_PRINTK=n
CONFIG_LOG=n
CONFIG_SHELL=n
CONFIG_BOOT_BANNER=n
```

## app.overlay
```dts
/* SPDX-License-Identifier: MIT */
#include "../arduino_smoke/app.overlay"
```

## src/main.cpp
```c
// SPDX-License-Identifier: MPL-2.0
#include <Arduino.h>
#include "vm/interp.h"
#include "vm/persist.h"

int main(void)
{
    hardwareInit();
    memInit();
    primsInit();
    restoreScripts();
    startAll();
    for (;;) {
        vmSlice(16);
        delay(1);
    }
}
```

## src/arduino_transport.cpp
```c
// SPDX-License-Identifier: MPL-2.0
#include <Arduino.h>
#include <Wire.h>
#include "vm/interp.h"
#include "generic_io.h"
#if defined(SMALLVM_WEBSOCKET)
extern "C" int mb_transport_recv(unsigned char *, int);
extern "C" int mb_transport_send(unsigned char *, int, int);
#endif

extern "C" void hardwareInit(void)
{
    initTasks();
#if !defined(SMALLVM_WEBSOCKET)
    Serial.begin(115200);
#endif
    Wire.begin();
}

extern "C" uint32 microsecs(void) { return micros(); }
extern "C" uint32 millisecs(void) { return millis(); }
extern "C" uint64 totalMicrosecs(void) { return k_ticks_to_us_floor64(k_uptime_ticks()); }
extern "C" uint32 seconds(void) { return millis() / 1000; }
extern "C" void handleMicosecondClockWrap(void) {}
extern "C" void smallvmDelay(unsigned long ms) { delay(ms); }
extern "C" void lightSleep(int ms) { if (ms > 0) delay(ms); }
extern "C" void deepSleep(int seconds) { (void)seconds; fail(primitiveNotImplemented); }

extern "C" int recvBytes(uint8 *dst, int count)
{
#if defined(SMALLVM_WEBSOCKET)
    return mb_transport_recv(dst, count);
#else
    int received = 0;
    while (received < count && Serial.available() > 0) {
        dst[received++] = Serial.read();
    }
    return received;
#endif
}

extern "C" int sendBytes(uint8 *data, int start, int end)
{
    if (start < 0 || end < start) return 0;
#if defined(SMALLVM_WEBSOCKET)
    return mb_transport_send(data, start, end);
#else
    return Serial.write(data + start, end - start);
#endif
}

extern "C" int pinCount(void) { return 3; }
extern "C" OBJ primDigitalPins(OBJ *) { return int2obj(3); }
extern "C" OBJ primAnalogPins(OBJ *) { return int2obj(2); }
extern "C" OBJ primDigitalRead(int count, OBJ *args)
{
    if (count < 1) return fail(notEnoughArguments);
    if (!isInt(args[0])) return fail(needsIntegerError);
    int pin = obj2int(args[0]);
    if (pin < 0 || pin >= 3) return fail(indexOutOfRangeError);
    rlcd_io_prepare_gpio(pin);
    pinMode(pin, INPUT);
    return digitalRead(pin) ? trueObj : falseObj;
}
extern "C" void primDigitalSet(int pin, int state)
{
    if (pin < 0 || pin >= 3) { fail(indexOutOfRangeError); return; }
    rlcd_io_prepare_gpio(pin);
    pinMode(pin, OUTPUT);
    digitalWrite(pin, state ? HIGH : LOW);
}
extern "C" void primDigitalWrite(OBJ *args)
{
    if (!isInt(args[0])) { fail(needsIntegerError); return; }
    primDigitalSet(obj2int(args[0]), args[1] != falseObj);
}
extern "C" void turnOffPins(void)
{
    rlcd_io_i2c_cancel();
    rlcd_io_pwm_stop();
    for (int pin = 0; pin < 3; ++pin) pinMode(pin, INPUT);
}
```

## src/generic_io.cpp
```c
/* SPDX-License-Identifier: MIT */
#include "generic_io.h"
#include <Arduino.h>
#include <zephyr/drivers/gpio.h>
#include <zephyr/drivers/i2c.h>
#include <zephyr/drivers/spi.h>
#include <zephyr/drivers/pwm.h>
#include <zephyr/drivers/pinctrl.h>
#include <errno.h>
#include <stdio.h>
#include <string.h>

static const device *const bus=DEVICE_DT_GET(DT_NODELABEL(i2c0));
static const device *const spi=DEVICE_DT_GET(DT_NODELABEL(spi3));
static const device *const pwm=DEVICE_DT_GET(DT_NODELABEL(ledc0));
static const device *const gpio=DEVICE_DT_GET(DT_NODELABEL(gpio0));
PINCTRL_DT_DEFINE(DT_NODELABEL(spi3));
PINCTRL_DT_DEFINE(DT_NODELABEL(ledc0));
static bool spi_initialized, pwm_initialized, pwm_active;
static unsigned spi_hz=1000000, spi_mode;
static bool spi_lsb;
static int last_error;
static uint8_t pending_i2c_data[32];
static size_t pending_i2c_count;
static unsigned pending_i2c_address;
/* Zephyr caches configuration by pointer identity. Alternate stable objects so
 * setup changes and retries are reapplied, without leaving a stack pointer. */
static spi_config spi_configs[2];
static unsigned spi_config_index;

static int initialize(const device *dev, bool *initialized)
{
    if (*initialized) return device_is_ready(dev) ? 0 : -ENODEV;
    int err=device_init(dev);
    if (err && err!=-EALREADY) return err;
    if (!device_is_ready(dev)) return -ENODEV;
    *initialized=true;
    return 0;
}

extern "C" int rlcd_io_i2c_get(unsigned address, unsigned reg, uint8_t *value)
{
    rlcd_io_i2c_cancel();
    if (address>127 || reg>255 || !value) return -EINVAL;
    if (!device_is_ready(bus)) return last_error=-ENODEV;
    return last_error=i2c_reg_read_byte(bus,address,reg,value);
}

extern "C" int rlcd_io_i2c_set(unsigned address, unsigned reg, uint8_t value)
{
    rlcd_io_i2c_cancel();
    if (address>127 || reg>255) return -EINVAL;
    if (!device_is_ready(bus)) return last_error=-ENODEV;
    return last_error=i2c_reg_write_byte(bus,address,reg,value);
}

extern "C" void rlcd_io_i2c_cancel(void) { pending_i2c_count=0; }

extern "C" int rlcd_io_i2c_read(unsigned address, uint8_t *data, size_t count)
{
    if (address>127 || count>32 || (!data && count)) return last_error=-EINVAL;
    if (!count) return 0;
    size_t pending=pending_i2c_count;
    rlcd_io_i2c_cancel();
    if (!device_is_ready(bus)) return last_error=-ENODEV;
    if (pending) {
        if (address!=pending_i2c_address) return last_error=-EINVAL;
        return last_error=i2c_write_read(bus,address,pending_i2c_data,pending,data,count);
    }
    return last_error=i2c_read(bus,data,count,address);
}

extern "C" int rlcd_io_i2c_write(unsigned address, const uint8_t *data, size_t count, bool stop)
{
    if (address>127 || count>32 || (!data && count)) return last_error=-EINVAL;
    if (!count) return 0;
    if (pending_i2c_count) {
        rlcd_io_i2c_cancel();
        return last_error=-EBUSY;
    }
    if (!device_is_ready(bus)) return last_error=-ENODEV;
    if (!stop) {
        memcpy(pending_i2c_data,data,count);
        pending_i2c_address=address;pending_i2c_count=count;
        return last_error=0;
    }
    return last_error=i2c_write(bus,data,count,address);
}

extern "C" int rlcd_io_i2c_exists(unsigned address)
{
    rlcd_io_i2c_cancel();
    if (address>127) return last_error=-EINVAL;
    if (!device_is_ready(bus)) return last_error=-ENODEV;
    uint8_t unused=0;
    return last_error=i2c_write(bus,&unused,0,address);
}

extern "C" int rlcd_io_spi_setup(unsigned hz, unsigned mode, bool lsb)
{
    if (hz<10000 || hz>8000000 || mode>3) return -EINVAL;
    spi_hz=hz;spi_mode=mode;spi_lsb=lsb;
    return 0; /* Configuration alone never initializes or drives external pins. */
}

extern "C" void rlcd_io_pwm_stop(void)
{
    if (!pwm_initialized || !pwm_active) return;
    pwm_set(pwm,0,1000000,0,0);
    gpio_pin_configure(gpio,17,GPIO_INPUT);
    pwm_active=false;
}

extern "C" void rlcd_io_prepare_gpio(unsigned pin)
{
    if (pin==2) rlcd_io_pwm_stop();
}

extern "C" int rlcd_io_spi_transfer(const uint8_t *tx, uint8_t *rx, size_t count)
{
    if (!count) return 0;
    if (!tx || count>256) return -EINVAL;
    rlcd_io_pwm_stop();
    int err=initialize(spi,&spi_initialized);
    if (!err) err=pinctrl_apply_state(PINCTRL_DT_DEV_CONFIG_GET(DT_NODELABEL(spi3)),PINCTRL_STATE_DEFAULT);
    if (!err) {
        spi_config &cfg=spi_configs[spi_config_index^=1];
        cfg={};
        cfg.frequency=spi_hz;
        cfg.operation=SPI_OP_MODE_MASTER | SPI_WORD_SET(8) |
            ((spi_mode&1) ? SPI_MODE_CPHA : 0) | ((spi_mode&2) ? SPI_MODE_CPOL : 0) |
            (spi_lsb ? SPI_TRANSFER_LSB : SPI_TRANSFER_MSB);
        spi_buf out={.buf=const_cast<uint8_t *>(tx),.len=count};
        spi_buf in={.buf=rx,.len=count};
        spi_buf_set outs={.buffers=&out,.count=1},ins={.buffers=&in,.count=1};
        err=spi_transceive(spi,&cfg,&outs,rx ? &ins : nullptr);
    }
    /* Restore high impedance after the explicitly requested transaction. */
    static const unsigned pins[]={1,2,17};
    for (unsigned pin: pins) {
        int release=gpio_pin_configure(gpio,pin,GPIO_INPUT);
        if (!err) err=release;
    }
    return last_error=err;
}

extern "C" int rlcd_io_analog_read(unsigned pin, unsigned mode, int *value)
{
    if (pin>1 || mode>2 || !value) return -EINVAL;
    pinMode(pin,mode==1 ? INPUT_PULLUP : mode==2 ? INPUT_PULLDOWN : INPUT);
    analogReadResolution(10);
    int sample=analogRead(pin);
    if (sample<0) return last_error=sample;
    if (sample>1023) return last_error=-ERANGE;
    *value=sample;
    return last_error=0;
}

extern "C" int rlcd_io_pwm_write(unsigned pin, unsigned value)
{
    if (pin!=2 || value>1023) return -EINVAL;
    int err=initialize(pwm,&pwm_initialized);
    if (!err) err=pinctrl_apply_state(PINCTRL_DT_DEV_CONFIG_GET(DT_NODELABEL(ledc0)),PINCTRL_STATE_DEFAULT);
    if (!err) err=pwm_set(pwm,0,1000000,(uint64_t)value*1000000/1023,0);
    if (!err) pwm_active=true;
    else gpio_pin_configure(gpio,17,GPIO_INPUT);
    return last_error=err;
}

extern "C" int rlcd_io_info(char *dst, unsigned size)
{
    snprintf(dst,size,"{\"digital_gpio\":[1,2,17],\"analog_gpio\":[1,2],\"analog_max\":1023,\"pwm_pin\":2,\"pwm_hz\":1000,\"dac\":false,\"i2c_gpio\":[13,14],\"i2c_pending\":%u,\"spi_gpio\":[1,2,17],\"spi_cs\":null,\"spi_hz\":%u,\"spi_mode\":%u,\"spi_lsb\":%d,\"spi_initialized\":%d,\"pwm_initialized\":%d,\"pwm_active\":%d,\"error\":%d}",
        (unsigned)pending_i2c_count,spi_hz,spi_mode,spi_lsb,spi_initialized,pwm_initialized,pwm_active,last_error);
    return 0;
}
```

## src/generic_io.h
```c
/* SPDX-License-Identifier: MIT */
#pragma once
#include <stddef.h>
#include <stdint.h>
#include <stdbool.h>
#ifdef __cplusplus
extern "C" {
#endif
int rlcd_io_i2c_get(unsigned address, unsigned reg, uint8_t *value);
int rlcd_io_i2c_set(unsigned address, unsigned reg, uint8_t value);
int rlcd_io_i2c_read(unsigned address, uint8_t *data, size_t count);
int rlcd_io_i2c_write(unsigned address, const uint8_t *data, size_t count, bool stop);
int rlcd_io_i2c_exists(unsigned address);
void rlcd_io_i2c_cancel(void);
int rlcd_io_spi_setup(unsigned hz, unsigned mode, bool lsb);
int rlcd_io_spi_transfer(const uint8_t *tx, uint8_t *rx, size_t count);
int rlcd_io_analog_read(unsigned pin, unsigned mode, int *value);
int rlcd_io_pwm_write(unsigned pin, unsigned value);
void rlcd_io_pwm_stop(void);
void rlcd_io_prepare_gpio(unsigned pin);
int rlcd_io_info(char *dst, unsigned size);
#ifdef __cplusplus
}
#endif
```

## src/generic_primitives.c
```c
/* SPDX-License-Identifier: MPL-2.0 */
/* Native opcode contracts follow the verified v417 ioPrims/sensorPrims.
 * Zephyr-facing operations are separate so this exact adapter can be tested
 * with the real 32-bit VM object representation and simulated drivers. */
#include "vm/interp.h"
#include "generic_io.h"
#include <string.h>

static OBJ i2c_failure(int error)
{
    rlcd_io_i2c_cancel();
    return fail(error);
}

OBJ primI2cGet(OBJ *args)
{
    rlcd_io_i2c_cancel();
    if (!isInt(args[0]) || !isInt(args[1])) return fail(needsIntegerError);
    int address=obj2int(args[0]), reg=obj2int(args[1]);
    if (address<0 || address>127) return fail(i2cDeviceIDOutOfRange);
    if (reg<0 || reg>255) return fail(i2cRegisterIDOutOfRange);
    uint8_t value;
    return rlcd_io_i2c_get(address,reg,&value) ? fail(i2cTransferFailed) : int2obj(value);
}

OBJ primI2cSet(OBJ *args)
{
    rlcd_io_i2c_cancel();
    if (!isInt(args[0]) || !isInt(args[1]) || !isInt(args[2])) return fail(needsIntegerError);
    int address=obj2int(args[0]), reg=obj2int(args[1]), value=obj2int(args[2]);
    if (address<0 || address>127) return fail(i2cDeviceIDOutOfRange);
    if (reg<0 || reg>255) return fail(i2cRegisterIDOutOfRange);
    if (value<0 || value>255) return fail(i2cValueOutOfRange);
    return rlcd_io_i2c_set(address,reg,value) ? fail(i2cTransferFailed) : falseObj;
}

OBJ primSPISend(OBJ *args)
{
    uint8_t byte;
    const uint8_t *data;
    size_t count;
    if (isInt(args[0])) {
        int value=obj2int(args[0]);
        if (value<0 || value>255) return fail(i2cValueOutOfRange);
        byte=value;data=&byte;count=1;
    } else if (IS_TYPE(args[0],ByteArrayType)) {
        data=(const uint8_t *)&FIELD(args[0],0);count=BYTES(args[0]);
        if (count>256) return fail(indexOutOfRangeError);
    } else return fail(needsIntegerError);
    if (!count) return falseObj;
    return rlcd_io_spi_transfer(data,NULL,count) ? fail(primitiveNotImplemented) : falseObj;
}

OBJ primSPIRecv(OBJ *args)
{
    (void)args;
    uint8_t zero=0, value;
    return rlcd_io_spi_transfer(&zero,&value,1) ? fail(primitiveNotImplemented) : int2obj(value);
}

OBJ primAnalogRead(int argc, OBJ *args)
{
    if (argc<1 || argc>2) return fail(notEnoughArguments);
    if (!isInt(args[0])) return fail(needsIntegerError);
    int pin=obj2int(args[0]);
    if (pin<0 || pin>1) return fail(badPinError);
    unsigned mode=0;
    if (argc==2) {
        if (args[1]==trueObj) mode=1;
        else if (IS_TYPE(args[1],StringType)) {
            if (!strcmp(obj2str(args[1]),"up")) mode=1;
            else if (!strcmp(obj2str(args[1]),"down")) mode=2;
        }
    }
    int value;
    return rlcd_io_analog_read(pin,mode,&value) ? fail(primitiveNotImplemented) : int2obj(value);
}

void primAnalogWrite(OBJ *args)
{
    if (!isInt(args[0]) || !isInt(args[1])) { fail(needsIntegerError);return; }
    if (obj2int(args[0])!=2) { fail(badPinError);return; }
    int value=obj2int(args[1]);
    if (value<0) value=0;
    if (value>1023) value=1023;
    if (rlcd_io_pwm_write(2,value)) fail(primitiveNotImplemented);
}

static OBJ spi_setup(int argc, OBJ *args)
{
    if (argc<1 || argc>4) return fail(notEnoughArguments);
    if (!isInt(args[0]) || (argc>1 && !isInt(args[1])) || (argc>2 && !isInt(args[2])))
        return fail(needsIntegerError);
    int hz=obj2int(args[0]),mode=argc>1 ? obj2int(args[1]) : 0;
    if (hz<10000 || hz>8000000 || mode<0 || mode>3) return fail(indexOutOfRangeError);
    if (argc>2 && obj2int(args[2])!=0) return fail(badPinError);
    bool lsb=false;
    if (argc>3) {
        if (!IS_TYPE(args[3],StringType)) return fail(needsStringError);
        if (!strcmp(obj2str(args[3]),"LSB")) lsb=true;
        else if (strcmp(obj2str(args[3]),"MSB")) return fail(indexOutOfRangeError);
    }
    return rlcd_io_spi_setup(hz,mode,lsb) ? fail(primitiveNotImplemented) : falseObj;
}

static OBJ spi_exchange(int argc, OBJ *args)
{
    if (argc!=1) return fail(notEnoughArguments);
    if (!IS_TYPE(args[0],ByteArrayType)) return fail(needsByteArray);
    size_t count=BYTES(args[0]);
    if (count>256) return fail(indexOutOfRangeError);
    if (!count) return falseObj;
    uint8_t *data=(uint8_t *)&FIELD(args[0],0);
    return rlcd_io_spi_transfer(data,data,count) ? fail(primitiveNotImplemented) : falseObj;
}

/* List storage includes a tagged logical count followed by its elements. */
static int list_count(OBJ list)
{
    if (!WORDS(list) || !isInt(FIELD(list,0))) return -1;
    int count=obj2int(FIELD(list,0));
    return count<0 || count>=WORDS(list) ? -1 : count;
}

static OBJ i2c_exists(int argc, OBJ *args)
{
    rlcd_io_i2c_cancel();
    if (argc<1 || !isInt(args[0])) return falseObj;
    int address=obj2int(args[0]);
    if (address<0 || address>127) return falseObj;
    return rlcd_io_i2c_exists(address) ? falseObj : trueObj;
}

static OBJ i2c_read(int argc, OBJ *args)
{
    if (argc<2 || !isInt(args[0])) { rlcd_io_i2c_cancel();return zeroObj; }
    int address=obj2int(args[0]);
    if (address<0 || address>127) return i2c_failure(i2cDeviceIDOutOfRange);
    OBJ target=args[1];
    bool list=IS_TYPE(target,ListType);
    int count;
    if (list) count=list_count(target);
    else if (IS_TYPE(target,ByteArrayType)) count=BYTES(target);
    else return i2c_failure(needsByteArray);
    if (count<0) return i2c_failure(indexOutOfRangeError);
    if (!count) return zeroObj;
    if (count>32) count=32;
    uint8_t data[32];
    /* Preserve v417's bounded-count/255-fill contract on failed reads. */
    if (rlcd_io_i2c_read(address,data,count)) memset(data,255,count);
    if (list) {
        for (int i=0;i<count;++i) FIELD(target,i+1)=int2obj(data[i]);
    } else memcpy(&FIELD(target,0),data,count);
    return int2obj(count);
}

static OBJ i2c_write(int argc, OBJ *args)
{
    if (argc<2 || !isInt(args[0])) { rlcd_io_i2c_cancel();return zeroObj; }
    int address=obj2int(args[0]);
    if (address<0 || address>127) return i2c_failure(i2cDeviceIDOutOfRange);
    OBJ source=args[1];
    uint8_t data[32];
    int count;
    if (isInt(source)) {
        int value=obj2int(source);
        if (value<0 || value>255) return i2c_failure(i2cValueOutOfRange);
        data[0]=value;count=1;
    } else if (IS_TYPE(source,ListType)) {
        count=list_count(source);
        if (count<0 || count>32) return i2c_failure(indexOutOfRangeError);
        for (int i=0;i<count;++i) {
            OBJ item=FIELD(source,i+1);
            if (!isInt(item) || obj2int(item)<0 || obj2int(item)>255) return i2c_failure(i2cValueOutOfRange);
            data[i]=obj2int(item);
        }
    } else if (IS_TYPE(source,ByteArrayType) || IS_TYPE(source,StringType)) {
        count=IS_TYPE(source,ByteArrayType) ? BYTES(source) : strlen(obj2str(source));
        if (count>32) return i2c_failure(indexOutOfRangeError);
        memcpy(data,&FIELD(source,0),count);
    } else return i2c_failure(needsByteArray);
    if (!count) { rlcd_io_i2c_cancel();return falseObj; }
    bool stop=argc<3 || args[2]==trueObj;
    return rlcd_io_i2c_write(address,data,count,stop) ? i2c_failure(i2cTransferFailed) : falseObj;
}

static PrimEntry generic_sensor_entries[] = {
    {"spiSetup",spi_setup}, {"spiExchange",spi_exchange},
    {"i2cExists",i2c_exists}, {"i2cRead",i2c_read}, {"i2cWrite",i2c_write}
};

void addSensorPrims(void)
{
    addPrimitiveSet(SensorPrims,"sensors",sizeof(generic_sensor_entries)/sizeof(generic_sensor_entries[0]),generic_sensor_entries);
}
```

## src/platform.c
```c
/* SPDX-License-Identifier: MPL-2.0 */
/* Minimal Zephyr platform; unsupported hardware reports an explicit VM error.
 * Interface pattern follows the existing speccy88/uno-q-microblocks port. */
#include "vm/interp.h"
#include "rlcd_board.h"
#include "rlcd_audio.h"
#include "generic_io.h"
#include <stdlib.h>
#include <string.h>

int useTFT, mbDisplayColor, resetDoubleTap, wifiActive, isCodingBox, isSpringbotGold;
int BLE_allowShutdown, BLE_connected_to_IDE, bleRunning;
char BLE_ThreeLetterID[4] = "---";
const char *boardType(void) { return "Waveshare RLCD 4.2 Zephyr"; }
void consolePrint(const char *s) { (void)s; }
void consoleReportNum(const char *s, int n) { (void)s; (void)n; }
void processFileMessage(int t, int n, char *p) { (void)t; (void)n; (void)p; }
void stopPWM(void) { rlcd_io_pwm_stop(); }
void stopServos(void) {}
void stopTone(void) { rlcd_audio_stop(); }
void resetRadio(void) {}
void turnOffInternalNeoPixels(void) {}
void tftClear(void) {}
void tftInit(void) {}
void updateMicrobitDisplay(void) {}
void restartSerial(void) {}
void BLE_start(void) {}
void BLE_stop(void) {}
void BLE_setEnabled(int n) { (void)n; }
int BLE_isEnabled(void) { return 0; }
int displayIsActive(void) { return 0; }
void getMACAddress(uint8 *p) { memset(p, 0, 6); }
OBJ primHexToInt(int n, OBJ *a) {
    if (n < 1) return fail(notEnoughArguments);
    if (!IS_TYPE(a[0], StringType)) return fail(needsStringError);
    return int2obj(strtol(obj2str(a[0]), 0, 16));
}
OBJ primButtonA(OBJ *a) { (void)a; return rlcd_button_pressed(0) ? trueObj : falseObj; }
OBJ primButtonB(OBJ *a) { (void)a; return rlcd_button_pressed(1) ? trueObj : falseObj; }
#define DISABLED_A(name) OBJ name(OBJ *a) { (void)a; return fail(primitiveNotImplemented); }
#define DISABLED_N(name) OBJ name(int n, OBJ *a) { (void)n; (void)a; return fail(primitiveNotImplemented); }
#define DISABLED_V(name) void name(OBJ *a) { (void)a; fail(primitiveNotImplemented); }
DISABLED_N(primMBDisplay) DISABLED_N(primMBEnableDisplay)
DISABLED_N(primMBPlot) DISABLED_N(primMBUnplot) DISABLED_N(primMBDrawShape) DISABLED_N(primMBShapeForLetter)
DISABLED_N(primMBTiltX) DISABLED_N(primMBTiltY) DISABLED_N(primMBTiltZ) DISABLED_N(primMBTemp)
OBJ primMBDisplayOff(int n, OBJ *a) { (void)n; (void)a; return falseObj; }
void primSetUserLED(OBJ *a) { if (a && a[0] != falseObj) fail(primitiveNotImplemented); }
#define OMIT(name) void name(void) {}
OMIT(addDisplayPrims) OMIT(addFilePrims) OMIT(addMiscPrims)
OMIT(addNetPrims) OMIT(addBLEPrims) OMIT(addRadioPrims)
OMIT(addSerialPrims) OMIT(addTFTPrims) OMIT(addHIDPrims) OMIT(addOneWirePrims)
OMIT(addCameraPrims) OMIT(addEncoderPrims) OMIT(addSDCardPrims) OMIT(addElecfreaksPrims)
OMIT(addElecfreaksSensorPrims) OMIT(addSoundPrims)
```
