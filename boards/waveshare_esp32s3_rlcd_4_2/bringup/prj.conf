## CMakeLists.txt
```
# SPDX-License-Identifier: MIT
cmake_minimum_required(VERSION 3.20.0)
find_package(Zephyr REQUIRED HINTS $ENV{ZEPHYR_BASE})
project(waveshare_rlcd_bringup)

target_sources(app PRIVATE src/main.c src/rlcd_board.c)
```

## prj.conf
```kconfig
# Phase 0/1 hardware diagnostic application. NOT the SmallVM image.
# Mainline Zephyr board: esp32s3_rlcd_4_2/esp32s3/procpu
CONFIG_GPIO=y
CONFIG_I2C=y
CONFIG_SPI=y
CONFIG_SENSOR=y
CONFIG_RTC=y
CONFIG_ADC=y
CONFIG_DISPLAY=y
CONFIG_INPUT=y
CONFIG_CONSOLE=y
CONFIG_PRINTK=y
CONFIG_SERIAL=y
CONFIG_SHELL=y
CONFIG_SHELL_BACKEND_SERIAL=y
CONFIG_MAIN_STACK_SIZE=8192
CONFIG_LOG=y
CONFIG_LOG_DEFAULT_LEVEL=3
# Optional Wi-Fi/BLE/SD/I2S deliberately omitted from this initial binary.
# Inspect config fragments and the hardware matrix before enabling them.
```

## storage.conf
```kconfig
# OPT-IN reference fragment; test separately after baseline builds.
# Exact symbol dependencies may need adjusting against the pinned Zephyr revision.
CONFIG_DISK_ACCESS=y
CONFIG_FILE_SYSTEM=y
CONFIG_FAT_FILESYSTEM_ELM=y
CONFIG_SDMMC_STACK=y
# This enables drivers, but the Phase-1 app does not yet mount/read the card.
```

## src/main.c
```c
// SPDX-License-Identifier: MIT
#include <zephyr/kernel.h>
#include <zephyr/sys/printk.h>
#include <zephyr/shell/shell.h>
#include <zephyr/drivers/display.h>
#include <errno.h>
#include <string.h>
#include "rlcd_board.h"

static int cmd_status(const struct shell *shell, size_t argc, char **argv)
{
    ARG_UNUSED(argc); ARG_UNUSED(argv);
    struct rlcd_device_status s;
    rlcd_probe(&s);
    shell_print(shell, "Zephyr Waveshare ESP32-S3-RLCD-4.2 [phase-1 driver probes]");
    shell_print(shell, "LCD=%d SHTC3=%d RTC=%d BUTTONS=%d BAT_ADC=%d I2C=%d SPI=%d SD=%d",
                s.display, s.shtc3, s.rtc, s.buttons, s.adc, s.i2c, s.spi, s.sd);
    shell_print(shell, "NOT PRESENT IN THIS BUILD: SmallVM, Arduino API, SD filesystem, Wi-Fi, BLE, audio codecs");
    return 0;
}

static int cmd_sensor(const struct shell *shell, size_t argc, char **argv)
{
    ARG_UNUSED(argc); ARG_UNUSED(argv);
    struct rlcd_environment env;
    int err = rlcd_environment_read(&env);
    if (err) { shell_error(shell, "SHTC3 read failed: %d", err); return err; }
    int64_t magnitude = env.temp_milli_c < 0 ? -(int64_t)env.temp_milli_c : env.temp_milli_c;
    shell_print(shell, "temperature = %s%d.%03d C, relative humidity = %d.%03d %%",
                env.temp_milli_c < 0 ? "-" : "", (int)(magnitude / 1000), (int)(magnitude % 1000),
                env.humidity_milli_pct / 1000, (int)(env.humidity_milli_pct % 1000));
    return 0;
}

static int cmd_rtc(const struct shell *shell, size_t argc, char **argv)
{
    ARG_UNUSED(argc); ARG_UNUSED(argv);
    char ts[32];
    int err = rlcd_rtc_read(ts, sizeof(ts));
    if (err) { shell_error(shell, "RTC read failed: %d", err); return err; }
    shell_print(shell, "PCF85063A = %s (uninitialized clocks may give invalid time)", ts);
    return 0;
}

static int cmd_battery(const struct shell *shell, size_t argc, char **argv)
{
    ARG_UNUSED(argc); ARG_UNUSED(argv);
    int32_t raw, voltage;
    int err = rlcd_battery_read(&raw, &voltage);
    if (err) { shell_error(shell, "battery ADC read failed: %d", err); return err; }
    shell_print(shell, "battery ADC raw=%ld", (long)raw);
    if (voltage >= 0) {
        shell_print(shell, "voltage divider x3: approximately %ld mV (not calibrated)", (long)voltage);
    } else {
        shell_print(shell, "millivolts unavailable without a supported ADC calibration/reference");
    }
    return 0;
}

static int cmd_buttons(const struct shell *shell, size_t argc, char **argv)
{
    ARG_UNUSED(argc); ARG_UNUSED(argv);
    shell_print(shell, "BOOT(GPIO0)=%d KEY(GPIO18)=%d", rlcd_button_pressed(0), rlcd_button_pressed(1));
    return 0;
}

static int cmd_display(const struct shell *shell, size_t argc, char **argv)
{
    ARG_UNUSED(argc);
    int err;
    if (argc == 1 || !strcmp(argv[1], "checker")) {
        err = rlcd_display_checkerboard();
    } else if (!strcmp(argv[1], "white")) {
        err = rlcd_display_clear(true);
    } else if (!strcmp(argv[1], "black")) {
        err = rlcd_display_clear(false);
    } else {
        shell_error(shell, "usage: hw display [checker|white|black]"); return -EINVAL;
    }
    if (err) { shell_error(shell, "display error: %d", err); return err; }
    shell_print(shell, "display frame sent. Inspect screen orientation and 300x400 visible crop.");
    return 0;
}

SHELL_STATIC_SUBCMD_SET_CREATE(hw_subcommands,
    SHELL_CMD(status, NULL, "Show ready devices and scope", cmd_status),
    SHELL_CMD(sensor, NULL, "Read SHTC3 temperature and humidity", cmd_sensor),
    SHELL_CMD(rtc, NULL, "Read PCF85063A RTC", cmd_rtc),
    SHELL_CMD(battery, NULL, "Read battery ADC", cmd_battery),
    SHELL_CMD(buttons, NULL, "Read BOOT and KEY", cmd_buttons),
    SHELL_CMD(display, NULL, "Display test: [checker|white|black]", cmd_display),
    SHELL_SUBCMD_SET_END);
SHELL_CMD_REGISTER(hw, &hw_subcommands, "Waveshare board diagnostics", NULL);

int main(void)
{
    printk("\nWaveshare ESP32-S3-RLCD-4.2 Zephyr hardware bring-up\n");
    printk("Use serial Zephyr shell: hw status; hw sensor; hw rtc; hw battery; hw buttons; hw display checker\n");
    struct rlcd_device_status s;
    rlcd_probe(&s);
    printk("Display ready=%d, sensor=%d, RTC=%d, battery ADC=%d\n",
           s.display, s.shtc3, s.rtc, s.adc);
    // Do not overwrite the user's current display on boot; run hw display explicitly.
    for (;;) {
        k_sleep(K_SECONDS(10));
    }
    return 0;
}
```

## src/rlcd_audio.c
```c
/*
 * SPDX-FileCopyrightText: 2023 Espressif Systems (Shanghai) CO LTD
 * SPDX-FileCopyrightText: 2026 MicroBlocks Zephyr contributors
 * SPDX-License-Identifier: Apache-2.0
 *
 * ES8311 register initialization adapted from Espressif esp_codec_dev,
 * distributed in Waveshare ESP32-S3-RLCD-4.2 revision a861929d91f25e7fbe2e0e014691f0fbedcaa64e.
 * See docs/AUDIO.md and LICENSES.md. Fixed-rate DAC output only.
 */
#include "rlcd_audio.h"
#include <errno.h>
#include <stdio.h>
#include <zephyr/kernel.h>

#if defined(CONFIG_I2S)
#include <zephyr/device.h>
#include <zephyr/drivers/gpio.h>
#include <zephyr/drivers/i2c.h>
#include <zephyr/drivers/i2s.h>
#include <zephyr/init.h>
#include <hal/gpio_ll.h>
#include <soc/gpio_struct.h>
#include <soc/i2s_struct.h>
#include <zephyr/sys/atomic.h>

#define RATE 24000u
#define FRAMES 256u
#define BLOCK_BYTES (FRAMES * 2u * sizeof(int16_t))
#define BLOCKS 4
static const struct device *const bus = DEVICE_DT_GET(DT_NODELABEL(i2c0));
static const struct device *const output = DEVICE_DT_GET(DT_NODELABEL(i2s0));
static const struct gpio_dt_spec amp = GPIO_DT_SPEC_GET(DT_PATH(zephyr_user), audio_amp_gpios);
K_MEM_SLAB_DEFINE(audio_slab, BLOCK_BYTES, BLOCKS, 4);
K_MUTEX_DEFINE(audio_lock);
K_SEM_DEFINE(audio_request, 0, 1);
static atomic_t busy, cancelled, initialized, blocks_queued, frames_queued;
static atomic_t completed_frames, last_error, elapsed_ms, starts;
static atomic_t lrck_hz;
static atomic_t lrck_edges;
static struct gpio_callback lrck_callback;
static int tone_hz, tone_ms, tone_volume;

static int audio_boot(void)
{
    return gpio_is_ready_dt(&amp) ? gpio_pin_configure_dt(&amp, GPIO_OUTPUT_INACTIVE) : -ENODEV;
}
SYS_INIT(audio_boot, APPLICATION, CONFIG_APPLICATION_INIT_PRIORITY);

static const int16_t sine[64] = {
    0,803,1598,2378,3135,3862,4551,5197,5793,6333,6811,7225,7568,7839,8035,8153,
    8192,8153,8035,7839,7568,7225,6811,6333,5793,5197,4551,3862,3135,2378,1598,803,
    0,-803,-1598,-2378,-3135,-3862,-4551,-5197,-5793,-6333,-6811,-7225,-7568,-7839,-8035,-8153,
    -8192,-8153,-8035,-7839,-7568,-7225,-6811,-6333,-5793,-5197,-4551,-3862,-3135,-2378,-1598,-803
};

static int reg_write(uint8_t reg, uint8_t value)
{
    return i2c_reg_write_byte(bus, 0x18, reg, value);
}

static int reg_read(uint8_t reg, uint8_t *value)
{
    return i2c_reg_read_byte(bus, 0x18, reg, value);
}

static int mute(bool value)
{
    uint8_t reg;
    int err = reg_read(0x31, &reg);
    return err ? err : reg_write(0x31, (reg & 0x9f) | (value ? 0x60 : 0));
}

static int codec_init(void)
{
    if (atomic_get(&initialized)) return 0;
    if (!device_is_ready(bus) || !device_is_ready(output) || !gpio_is_ready_dt(&amp))
        return -ENODEV;
    int err = gpio_pin_configure_dt(&amp, GPIO_OUTPUT_INACTIVE);
    if (err) return err;
    uint8_t id1, id2;
    if ((err = reg_read(0xfd, &id1)) || (err = reg_read(0xfe, &id2))) return err;
    if (id1 != 0x83 || id2 != 0x11) return -ENODEV;
    /* Vendor open/start sequence; PA stays off. ADC serial output disabled.
     * MCLK/FS = 256, pre_div=1, pre_multi=1, DAC OSR=16 at 24 kHz.
     * 0x32=0xbf is 0 dB DAC gain; amplitude is bounded in PCM, not positive gain. */
    static const uint8_t setup[][2] = {
        {0x44,0x08},{0x44,0x08},{0x01,0x30},{0x02,0x00},{0x03,0x10},
        {0x16,0x24},{0x04,0x10},{0x05,0x00},{0x0b,0x00},{0x0c,0x00},
        {0x10,0x1f},{0x11,0x7f},{0x00,0x80},{0x01,0x3f},{0x06,0x03},
        {0x13,0x10},{0x1b,0x0a},{0x1c,0x6a},{0x44,0x58},
        {0x02,0x00},{0x03,0x10},{0x04,0x10},{0x05,0x00},{0x07,0x00},{0x08,0xff},
        {0x09,0x0c},{0x0a,0x4c},{0x17,0xbf},{0x0e,0x02},{0x12,0x00},
        {0x14,0x1a},{0x0d,0x01},{0x15,0x40},{0x37,0x08},{0x45,0x00},
        {0x32,0xbf},{0x31,0x60}
    };
    for (unsigned i = 0; i < ARRAY_SIZE(setup); ++i)
        if ((err = reg_write(setup[i][0], setup[i][1]))) return err;
    k_sleep(K_MSEC(20));
    atomic_set(&initialized, 1);
    return 0;
}

static int configure(void)
{
    struct i2s_config cfg = {
        .word_size = 16, .channels = 2,
        .format = I2S_FMT_DATA_FORMAT_I2S,
        .options = I2S_OPT_FRAME_CLK_CONTROLLER | I2S_OPT_BIT_CLK_CONTROLLER,
        .frame_clk_freq = RATE, .mem_slab = &audio_slab,
        .block_size = BLOCK_BYTES, .timeout = 100
    };
    return i2s_configure(output, I2S_DIR_TX, &cfg);
}

static void count_lrck(const struct device *port, struct gpio_callback *cb, gpio_port_pins_t pins)
{
    ARG_UNUSED(port); ARG_UNUSED(cb); ARG_UNUSED(pins);
    atomic_inc(&lrck_edges);
}

static void measure_lrck(void)
{
    /* Count edges with the GPIO peripheral, avoiding polling aliasing. The
     * input-enable bit does not change the I2S output matrix. */
    gpio_ll_input_enable(&GPIO, 45);
    gpio_init_callback(&lrck_callback, count_lrck, BIT(13));
    gpio_add_callback(amp.port, &lrck_callback);
    atomic_clear(&lrck_edges);
    uint32_t start = k_cycle_get_32();
    int err = gpio_pin_interrupt_configure(amp.port, 13, GPIO_INT_EDGE_RISING);
    if (!err) k_sleep(K_MSEC(5));
    gpio_pin_interrupt_configure(amp.port, 13, GPIO_INT_DISABLE);
    uint32_t usecs = k_cyc_to_us_floor32(k_cycle_get_32() - start);
    gpio_remove_callback(amp.port, &lrck_callback);
    atomic_set(&lrck_hz, err ? err : atomic_get(&lrck_edges) * 1000000u / usecs);
}

static void audio_worker(void *a, void *b, void *c)
{
    ARG_UNUSED(a); ARG_UNUSED(b); ARG_UNUSED(c);
    for (;;) {
        k_sem_take(&audio_request, K_FOREVER);
        k_mutex_lock(&audio_lock, K_FOREVER);
        int frequency = tone_hz, duration = tone_ms, volume = tone_volume;
        k_mutex_unlock(&audio_lock);
        int64_t began = k_uptime_get();
        uint32_t total = duration * (RATE / 1000), generated = 0, phase = 0;
        uint32_t step = (uint64_t)frequency * UINT64_C(4294967296) / RATE;
        int err = configure();
        bool started = false;
        while (!err && generated < total && !atomic_get(&cancelled)) {
            void *block;
            err = k_mem_slab_alloc(&audio_slab, &block, K_MSEC(100));
            if (err) break;
            int16_t *pcm = block;
            unsigned count = MIN(FRAMES, total - generated);
            for (unsigned i = 0; i < count; ++i) {
                unsigned pos = generated + i;
                unsigned ramp = MIN(120u, MIN(pos, total - 1u - pos));
                int32_t sample = (int32_t)sine[phase >> 26] * volume / 100;
                sample = sample * (int32_t)ramp / 120;
                pcm[2*i] = pcm[2*i+1] = (int16_t)sample;
                phase += step;
            }
            err = i2s_write(output, block, count * 2u * sizeof(int16_t));
            if (err) { k_mem_slab_free(&audio_slab, block); break; }
            generated += count;
            atomic_inc(&blocks_queued);
            atomic_add(&frames_queued, count);
            /* Prequeue two DMA blocks before enabling the amplifier. */
            if (!started && (generated >= 2 * FRAMES || generated == total)) {
                err = i2s_trigger(output, I2S_DIR_TX, I2S_TRIGGER_START);
                if (!err) started = true;
                if (!err && !atomic_get(&cancelled)) err = mute(false);
                if (!err && !atomic_get(&cancelled) && volume) err = gpio_pin_set_dt(&amp, 1);
                if (!err) measure_lrck();
            }
        }
        if (!err && started && !atomic_get(&cancelled)) {
            err = i2s_trigger(output, I2S_DIR_TX, I2S_TRIGGER_DRAIN);
            /* Driver releases DMA blocks only from completion callbacks.
             * A bounded wait proves reclamation; timeout mutes and drops. */
            int64_t deadline = k_uptime_get() + 300;
            while (!err && k_mem_slab_num_free_get(&audio_slab) != BLOCKS && !atomic_get(&cancelled)) {
                if (k_uptime_get() > deadline) { err = -ETIMEDOUT; break; }
                k_sleep(K_MSEC(1));
            }
            if (!err && !atomic_get(&cancelled)) atomic_set(&completed_frames, generated);
        }
        gpio_pin_set_dt(&amp, 0);
        int mute_err = mute(true);
        if (!err) err = mute_err;
        i2s_trigger(output, I2S_DIR_TX, I2S_TRIGGER_DROP);
        atomic_set(&elapsed_ms, (atomic_val_t)(k_uptime_get() - began));
        atomic_set(&last_error, err);
        atomic_clear(&busy);
    }
}
K_THREAD_DEFINE(audio_thread, 2048, audio_worker, NULL, NULL, NULL, 6, 0, 0);

int rlcd_audio_play(int frequency, int duration_ms, int volume)
{
    if (frequency < 50 || frequency > 4000 || duration_ms < 1 || duration_ms > 5000 || volume < 0 || volume > 100)
        return -EINVAL;
    k_mutex_lock(&audio_lock, K_FOREVER);
    if (atomic_get(&busy)) { k_mutex_unlock(&audio_lock); return -EBUSY; }
    int err = codec_init();
    if (!err) {
        tone_hz = frequency; tone_ms = duration_ms; tone_volume = volume;
        atomic_clear(&cancelled); atomic_clear(&blocks_queued); atomic_clear(&frames_queued);
        atomic_clear(&completed_frames); atomic_clear(&last_error); atomic_clear(&elapsed_ms);
        atomic_set(&busy, 1); atomic_inc(&starts); k_sem_give(&audio_request);
    } else atomic_set(&last_error, err);
    k_mutex_unlock(&audio_lock);
    return err;
}

void rlcd_audio_stop(void)
{
    atomic_set(&cancelled, 1);
    if (atomic_get(&initialized)) gpio_pin_set_dt(&amp, 0);
}

bool rlcd_audio_busy(void) { return atomic_get(&busy) != 0; }

int rlcd_audio_status(char *dst, unsigned size)
{
    if (!device_is_ready(bus)) return -ENODEV;
    uint8_t id1, id2, format, clock, dac, gain, muted;
    int err = reg_read(0xfd, &id1);
    if (!err) err = reg_read(0xfe, &id2);
    if (!err) err = reg_read(0x09, &format);
    if (!err) err = reg_read(0x01, &clock);
    if (!err) err = reg_read(0x04, &dac);
    if (!err) err = reg_read(0x32, &gain);
    if (!err) err = reg_read(0x31, &muted);
    if (err) return err;
    snprintf(dst, size, "{\"id\":\"%02x%02x\",\"ready\":%d,\"busy\":%d,\"format\":%u,\"clock\":%u,\"dac_osr\":%u,\"gain\":%u,\"mute\":%u,\"amp\":%d,\"rate\":%u,\"lrck_hz\":%ld,\"bits\":%u,\"slot\":%u,\"channels\":%u,\"blocks\":%ld,\"queued_frames\":%ld,\"completed_frames\":%ld,\"free_blocks\":%u,\"starts\":%ld,\"elapsed_ms\":%ld,\"error\":%ld}",
        id1, id2, (int)atomic_get(&initialized), (int)atomic_get(&busy), format, clock, dac, gain, muted,
        atomic_get(&initialized) ? gpio_pin_get_dt(&amp) : 0, RATE, (long)atomic_get(&lrck_hz),
        I2S0.tx_conf1.tx_bits_mod+1u, I2S0.tx_conf1.tx_tdm_chan_bits+1u, I2S0.tx_tdm_ctrl.tx_tdm_tot_chan_num+1u,
        (long)atomic_get(&blocks_queued), (long)atomic_get(&frames_queued), (long)atomic_get(&completed_frames),
        k_mem_slab_num_free_get(&audio_slab), (long)atomic_get(&starts), (long)atomic_get(&elapsed_ms), (long)atomic_get(&last_error));
    return 0;
}
#else
int rlcd_audio_play(int frequency, int duration_ms, int volume)
{ ARG_UNUSED(frequency); ARG_UNUSED(duration_ms); ARG_UNUSED(volume); return -ENOTSUP; }
void rlcd_audio_stop(void) {}
bool rlcd_audio_busy(void) { return false; }
int rlcd_audio_status(char *dst, unsigned size)
{ ARG_UNUSED(dst); ARG_UNUSED(size); return -ENOTSUP; }
#endif
```

## src/rlcd_audio.h
```c
/* SPDX-License-Identifier: MIT */
#pragma once
#include <stdbool.h>
int rlcd_audio_play(int frequency, int duration_ms, int volume);
void rlcd_audio_stop(void);
bool rlcd_audio_busy(void);
int rlcd_audio_status(char *dst, unsigned size);
```

## src/rlcd_board.c
```c
// SPDX-License-Identifier: MIT
#include "rlcd_board.h"
#include "rlcd_calendar.h"

#include <errno.h>
#include <string.h>
#include <stdio.h>
#include <zephyr/kernel.h>
#include <zephyr/device.h>
#include <zephyr/devicetree.h>
#include <zephyr/drivers/sensor.h>
#include <zephyr/drivers/rtc.h>
#include <zephyr/drivers/adc.h>
#include <zephyr/drivers/display.h>
#include <zephyr/drivers/i2c.h>
#include <zephyr/drivers/spi.h>
#include <zephyr/input/input.h>
#include <zephyr/dt-bindings/input/input-event-codes.h>
#include <zephyr/sys/util.h>
#include <zephyr/sys/atomic.h>
#if defined(CONFIG_CHARACTER_FRAMEBUFFER)
#include <zephyr/display/cfb.h>
#endif

// Exact labels and aliases verified against Zephyr's official board DTS.
#define RLCD_DISPLAY_NODE DT_CHOSEN(zephyr_display)
#define RLCD_SHTC3_NODE   DT_NODELABEL(shtc3)
#define RLCD_RTC_NODE     DT_NODELABEL(rtc0)
#define RLCD_I2C_NODE     DT_NODELABEL(i2c0)
#define RLCD_SPI_NODE     DT_NODELABEL(spi2)
#define RLCD_BATT_NODE    DT_NODELABEL(vbatt)

#if !DT_NODE_EXISTS(RLCD_DISPLAY_NODE) || !DT_NODE_EXISTS(RLCD_SHTC3_NODE) || \
    !DT_NODE_EXISTS(RLCD_RTC_NODE) || !DT_NODE_EXISTS(RLCD_BATT_NODE)
#error "Expected esp32s3_rlcd_4_2/esp32s3/procpu Devicetree nodes are absent"
#endif

static const struct device *const display_dev = DEVICE_DT_GET(RLCD_DISPLAY_NODE);
static const struct device *const temp_dev = DEVICE_DT_GET(RLCD_SHTC3_NODE);
static const struct device *const rtc_dev = DEVICE_DT_GET(RLCD_RTC_NODE);
static const struct device *const i2c_dev = DEVICE_DT_GET(RLCD_I2C_NODE);
static const struct device *const spi_dev = DEVICE_DT_GET(RLCD_SPI_NODE);
static const struct device *const buttons_dev = DEVICE_DT_GET(DT_PATH(buttons));
static const struct adc_dt_spec batt_adc = ADC_DT_SPEC_GET_BY_IDX(RLCD_BATT_NODE, 0);

#define DISP_W DT_PROP(RLCD_DISPLAY_NODE, width)
#define DISP_H DT_PROP(RLCD_DISPLAY_NODE, height)
BUILD_ASSERT(DISP_W % 8 == 0, "ST730x monochrome framebuffer needs byte-aligned width");
BUILD_ASSERT(DISP_W % 12 == 0, "ST730x writes need 12-pixel column alignment");
BUILD_ASSERT(DISP_H % 2 == 0, "ST730x writes need paired rows");
BUILD_ASSERT((DISP_W * DISP_H) % 8 == 0, "monochrome buffer size must be integral");
static uint8_t display_frame[DISP_W * DISP_H / 8];
static K_MUTEX_DEFINE(display_mutex);
static atomic_t btn0;
static atomic_t btn1;
static bool adc_configured;

static void button_callback(struct input_event *event, void *user_data)
{
    ARG_UNUSED(user_data);
    if (event->type != INPUT_EV_KEY) {
        return;
    }
    if (event->code == INPUT_KEY_0) {
        atomic_set(&btn0, event->value != 0);
    } else if (event->code == INPUT_KEY_1) {
        atomic_set(&btn1, event->value != 0);
    }
}
INPUT_CALLBACK_DEFINE(NULL, button_callback, NULL);

bool rlcd_button_pressed(unsigned index)
{
    return index == 0 ? atomic_get(&btn0) != 0 :
           index == 1 ? atomic_get(&btn1) != 0 : false;
}

void rlcd_probe(struct rlcd_device_status *out)
{
    if (!out) { return; }
    memset(out, 0, sizeof(*out));
    out->display = device_is_ready(display_dev);
    out->shtc3 = device_is_ready(temp_dev);
    out->rtc = device_is_ready(rtc_dev);
    out->buttons = device_is_ready(buttons_dev); // Event delivery still needs a physical test.
    out->adc = adc_is_ready_dt(&batt_adc);
    out->i2c = device_is_ready(i2c_dev);
    out->spi = device_is_ready(spi_dev);
    // SDMMC not built into phase-1 application; the DTS node exists upstream.
    out->sd = false;
}

int rlcd_environment_read(struct rlcd_environment *out)
{
    if (!out) { return -EINVAL; }
    if (!device_is_ready(temp_dev)) { return -ENODEV; }
    int err = sensor_sample_fetch(temp_dev);
    if (err) { return err; }
    struct sensor_value temp, humidity;
    err = sensor_channel_get(temp_dev, SENSOR_CHAN_AMBIENT_TEMP, &temp);
    if (err) { return err; }
    err = sensor_channel_get(temp_dev, SENSOR_CHAN_HUMIDITY, &humidity);
    if (err) { return err; }
    // Zephyr sensor_value uses val1 + val2 / 1,000,000.
    out->temp_milli_c = temp.val1 * 1000 + temp.val2 / 1000;
    out->humidity_milli_pct = humidity.val1 * 1000 + humidity.val2 / 1000;
    return 0;
}

int rlcd_rtc_read(char *dst, unsigned dst_size)
{
    if (!dst || dst_size < 21) { return -EINVAL; }
    if (!device_is_ready(rtc_dev)) { return -ENODEV; }
    struct rtc_time t;
    int err = rtc_get_time(rtc_dev, &t);
    if (err) { return err; }
    // RTC may not have been initialized yet; time shouldn't be treated as valid automatically.
    int n = snprintf(dst, dst_size, "%04d-%02d-%02d %02d:%02d:%02d",
        t.tm_year + 1900, t.tm_mon + 1, t.tm_mday,
        t.tm_hour, t.tm_min, t.tm_sec);
    return (n >= 0 && (unsigned)n < dst_size) ? 0 : -ENOSPC;
}

int rlcd_rtc_set_utc(int year, int month, int day, int hour, int minute, int second)
{
    int weekday = rlcd_utc_weekday(year, month, day, hour, minute, second);
    if (weekday < 0) return -EINVAL;
    if (!device_is_ready(rtc_dev)) return -ENODEV;
    struct rtc_time value = {
        .tm_year = year - 1900, .tm_mon = month - 1, .tm_mday = day,
        .tm_hour = hour, .tm_min = minute, .tm_sec = second,
        .tm_wday = weekday, .tm_yday = -1, .tm_isdst = 0, .tm_nsec = 0,
    };
    return rtc_set_time(rtc_dev, &value);
}

int rlcd_battery_read(int32_t *raw, int32_t *mv_estimate)
{
    if (!raw) { return -EINVAL; }
    if (!adc_is_ready_dt(&batt_adc)) { return -ENODEV; }
    if (!adc_configured) {
        int err = adc_channel_setup_dt(&batt_adc);
        if (err) { return err; }
        adc_configured = true;
    }
    int16_t sample = 0;
    struct adc_sequence sequence = { .buffer = &sample, .buffer_size = sizeof(sample) };
    int err = adc_sequence_init_dt(&batt_adc, &sequence);
    if (err) { return err; }
    err = adc_read_dt(&batt_adc, &sequence);
    if (err) { return err; }
    *raw = sample;
    if (mv_estimate) {
        int32_t mv = sample;
        // On ESP32 calibration isn't guaranteed; -ENOTSUP means report raw only.
        err = adc_raw_to_millivolts_dt(&batt_adc, &mv);
        *mv_estimate = (err == 0) ?
            (int32_t)((int64_t)mv * DT_PROP(RLCD_BATT_NODE, full_ohms) /
                      DT_PROP(RLCD_BATT_NODE, output_ohms)) : -1;
    }
    return 0;
}

static int push_display(void)
{
    if (!device_is_ready(display_dev)) { return -ENODEV; }
    struct display_capabilities caps;
    display_get_capabilities(display_dev, &caps);
    if (caps.current_pixel_format != PIXEL_FORMAT_MONO01 ||
        caps.x_resolution != DISP_W || caps.y_resolution != DISP_H ||
        caps.screen_info != 0) {
        return -ENOTSUP;
    }
    const struct display_buffer_descriptor desc = {
        .buf_size = sizeof(display_frame),
        .width = DISP_W,
        .height = DISP_H,
        .pitch = DISP_W,
    };
    int err = display_blanking_off(display_dev);
    if (err && err != -ENOSYS) { return err; }
    return display_write(display_dev, 0, 0, &desc, display_frame);
}

int rlcd_display_clear(bool white)
{
    k_mutex_lock(&display_mutex, K_FOREVER);
    memset(display_frame, white ? 0xFF : 0x00, sizeof(display_frame));
    int err = push_display();
    k_mutex_unlock(&display_mutex);
    return err;
}

int rlcd_display_checkerboard(void)
{
    k_mutex_lock(&display_mutex, K_FOREVER);
    memset(display_frame, 0, sizeof(display_frame));
    // 24px squares, 1bpp, logical bitmap; display orientation requires physical check.
    for (unsigned y = 0; y < DISP_H; ++y) {
        for (unsigned x = 0; x < DISP_W; ++x) {
            bool white = ((x / 24u) + (y / 24u)) % 2u == 0;
            if (white) {
                unsigned i = y * DISP_W + x;
                display_frame[i >> 3] |= 0x80u >> (i & 7u);
            }
        }
    }
    int err = push_display();
    k_mutex_unlock(&display_mutex);
    return err;
}

int rlcd_display_text(const char *text)
{
#if defined(CONFIG_CHARACTER_FRAMEBUFFER)
    static bool initialized;
    int err = 0;
    k_mutex_lock(&display_mutex, K_FOREVER);
    if (!initialized) {
        err = cfb_framebuffer_init(display_dev);
        if (err) goto done;
        initialized = true;
    }
    uint8_t width = 0, height = 0;
    for (int font = 0; font < 16; ++font) {
        if (cfb_get_font_size(display_dev, font, &width, &height)) break;
        cfb_framebuffer_set_font(display_dev, font);
        if (width <= 12 && height >= 16) break;
    }
    cfb_framebuffer_clear(display_dev, false);
    unsigned y = 12;
    while (*text && y + height < DISP_H) {
        char line[48];
        size_t n = 0;
        while (*text && *text != '\n' && n < MIN(sizeof(line) - 1, 276u / MAX(width, 1u))) {
            line[n++] = *text++;
        }
        line[n] = 0;
        err = cfb_print(display_dev, line, 18, y);
        if (err) goto done;
        if (*text == '\n') ++text;
        y += height + 4;
    }
    err = display_blanking_off(display_dev);
    if (!err) err = cfb_framebuffer_finalize(display_dev);
done:
    k_mutex_unlock(&display_mutex);
    return err;
#else
    ARG_UNUSED(text);
    return -ENOTSUP;
#endif
}
```

## src/rlcd_board.h
```c
// SPDX-License-Identifier: MIT
#pragma once
#include <stdint.h>
#include <stdbool.h>

// Stable Zephyr-facing board API. The same calls will be exposed to SmallVM
// primitives later; no direct Arduino/ESP-IDF dependency in this layer.
struct rlcd_device_status {
    bool display, shtc3, rtc, buttons, adc, i2c, spi, sd;
};

struct rlcd_environment {
    int32_t temp_milli_c;
    int32_t humidity_milli_pct;
};

void rlcd_probe(struct rlcd_device_status *out);
int rlcd_environment_read(struct rlcd_environment *out);
int rlcd_rtc_read(char *dst, unsigned dst_size);
int rlcd_rtc_set_utc(int year, int month, int day, int hour, int minute, int second);
int rlcd_battery_read(int32_t *raw, int32_t *mv_estimate);
int rlcd_display_checkerboard(void);
int rlcd_display_clear(bool white);
int rlcd_display_text(const char *text);
bool rlcd_button_pressed(unsigned index);
```

## src/rlcd_calendar.h
```c
/* SPDX-License-Identifier: MIT */
#pragma once

/* PCF85063A stores 2000..2099. Return Sunday=0..Saturday=6, or -1.
 * Validate the complete Gregorian date before any RTC/I2C operation. */
static inline int rlcd_utc_weekday(int year, int month, int day,
                                 int hour, int minute, int second)
{
    static const unsigned char month_days[] = {31,28,31,30,31,30,31,31,30,31,30,31};
    static const unsigned char weekday_offsets[] = {0,3,2,5,0,3,5,1,4,6,2,4};
    if (year < 2000 || year > 2099 || month < 1 || month > 12 ||
        hour < 0 || hour > 23 || minute < 0 || minute > 59 || second < 0 || second > 59)
        return -1;
    int limit = month_days[month - 1];
    if (month == 2 && (year % 4 == 0) && ((year % 100 != 0) || (year % 400 == 0))) ++limit;
    if (day < 1 || day > limit) return -1;
    int y = year - (month < 3);
    return (y + y / 4 - y / 100 + y / 400 + weekday_offsets[month - 1] + day) % 7;
}
```
