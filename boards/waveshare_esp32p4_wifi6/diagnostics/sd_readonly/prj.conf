## CMakeLists.txt
```
# SPDX-License-Identifier: MPL-2.0
cmake_minimum_required(VERSION 3.28)
find_package(Zephyr REQUIRED HINTS $ENV{ZEPHYR_BASE})
project(p4_sd_readonly LANGUAGES C)
get_filename_component(repo "${CMAKE_CURRENT_SOURCE_DIR}/../../../.." ABSOLUTE)
execute_process(COMMAND ${Python3_EXECUTABLE} "${repo}/tools/apply_p4_zephyr_patches.py"
  --zephyr "${ZEPHYR_BASE}" --require-applied COMMAND_ERROR_IS_FATAL ANY)
target_sources(app PRIVATE src/main.c src/probe.c)
```

## prj.conf
```kconfig
CONFIG_SERIAL=y
CONFIG_CONSOLE=y
CONFIG_UART_CONSOLE=y
CONFIG_PRINTK=y
CONFIG_LOG=n
CONFIG_MAIN_STACK_SIZE=4096
CONFIG_FILE_SYSTEM=y
CONFIG_DISK_DRIVERS=y
CONFIG_DISK_DRIVER_SDMMC=y
CONFIG_FAT_FILESYSTEM_ELM=y
CONFIG_FS_FATFS_READ_ONLY=y
CONFIG_FS_FATFS_MOUNT_MKFS=n
CONFIG_FS_FATFS_MKFS=n
CONFIG_FILE_SYSTEM_MKFS=n
CONFIG_FS_FATFS_NUM_FILES=1
CONFIG_FS_FATFS_NUM_DIRS=1
# Initial diagnostic uses short aliases; long-name editing is a later feature.
CONFIG_FS_FATFS_LFN=n
CONFIG_SD_INIT_TIMEOUT=1500
CONFIG_SD_RETRY_COUNT=2
CONFIG_SD_OCR_RETRY_COUNT=10
CONFIG_SD_CMD_TIMEOUT=200
CONFIG_SD_DATA_TIMEOUT=1000
CONFIG_SD_DATA_RETRIES=1
CONFIG_ASSERT=y
```

## app.overlay
```dts
/* SPDX-License-Identifier: Apache-2.0 */
/* Slot 0 and its pins/power come from the exact compact-board DTS. */
&sdhc0 { status = "okay"; max-bus-freq = <20000000>; };
&sdhc1 { status = "disabled"; };
```

## src/main.c
```c
/* SPDX-License-Identifier: MIT */
#include "probe.h"
#include <zephyr/kernel.h>
#include <zephyr/device.h>
#include <zephyr/drivers/uart.h>
#include <zephyr/sys/printk.h>
#include <inttypes.h>
BUILD_ASSERT(DT_NODE_HAS_STATUS(DT_NODELABEL(sdhc0),okay),"SD slot 0 required");
BUILD_ASSERT(!DT_NODE_HAS_STATUS(DT_NODELABEL(sdhc1),okay),"Isolated probe excludes C6 slot 1");
int main(void)
{
 const struct device *uart=DEVICE_DT_GET(DT_CHOSEN(zephyr_console));
 if(!device_is_ready(uart))return -ENODEV;
 printk("P4 SD read-only diagnostic; NOT MicroBlocks. Send T for one probe.\n");
 for(;;){
  unsigned char command;
  if(uart_poll_in(uart,&command)==0 && command=='T'){
   struct p4_sd_probe_result r;int e=p4_sd_readonly_probe(&r);
   printk("SDRO error=%d card_bytes=%" PRIu64 " free_available=%u free_error=%d free=%" PRIu64 " entries=%u files=%u dirs=%u truncated=%u close=%d unmount=%d\n",
    e,r.card_bytes,(unsigned)r.free_space_available,r.free_space_error,r.free_bytes,r.entries,r.files,r.directories,(unsigned)r.truncated,r.close_error,r.unmount_error);
  }
  k_sleep(K_MSEC(20));
 }
}
```

## src/probe.c
```c
/* SPDX-License-Identifier: MIT */
#include "probe.h"
#include <errno.h>
#include <string.h>
#include <zephyr/fs/fs.h>
#include <zephyr/storage/disk_access.h>
#include <ff.h>
#if (!defined(CONFIG_FS_FATFS_READ_ONLY) && !defined(CONFIG_P4_SD_FILES)) || defined(CONFIG_FS_FATFS_MKFS) || defined(CONFIG_FS_FATFS_MOUNT_MKFS)
#error "SD probe requires read-only FatFs with all formatting disabled"
#endif
static FATFS filesystem;
static struct fs_mount_t mountpoint={
 .type=FS_FATFS,.mnt_point="/SD:",.fs_data=&filesystem,
 .flags=FS_MOUNT_FLAG_READ_ONLY|FS_MOUNT_FLAG_NO_FORMAT
};
int p4_sd_readonly_probe_controlled(struct p4_sd_probe_result *r,int (*stop)(void *),void *context)
{
 if(!r)return -EINVAL;
 memset(r,0,sizeof(*r));
 int e=stop?stop(context):0;
 if(e){r->error=e;return e;}
 e=fs_mount(&mountpoint);
 if(e){r->error=e;return e;}
 struct fs_statvfs stat={0};
 struct fs_dir_t directory;fs_dir_t_init(&directory);
 bool opened=false;
 uint32_t sectors=0,sector_bytes=0;
 r->filesystem_type=filesystem.fs_type;
 if(r->filesystem_type<FS_FAT12||r->filesystem_type>FS_FAT32){e=-ENOTSUP;goto cleanup;}
 if(stop && (e=stop(context)))goto cleanup;
 e=disk_access_ioctl("SD",DISK_IOCTL_GET_SECTOR_COUNT,&sectors);
 if(e)goto cleanup;
 if(stop && (e=stop(context)))goto cleanup;
 e=disk_access_ioctl("SD",DISK_IOCTL_GET_SECTOR_SIZE,&sector_bytes);
 if(e)goto cleanup;
 if(!sectors || !sector_bytes){e=-EOVERFLOW;goto cleanup;}
 r->card_bytes=(uint64_t)sectors*sector_bytes;
 if(stop && (e=stop(context)))goto cleanup;
#if defined(CONFIG_P4_SD_FILES)
 /* f_getfree may scan the entire FAT on writable builds. This metadata check
  * deliberately keeps its former scope instead of silently adding that work. */
 e=-ENOTSUP;
#else
 e=fs_statvfs("/SD:",&stat);
#endif
 r->free_space_error=e;
 /* Pinned FatFs deliberately excludes f_getfree when FF_FS_READONLY=1. */
 if(e && e!=-ENOTSUP)goto cleanup;
 if(!e){
 if(!stat.f_frsize || stat.f_bfree>stat.f_blocks ||
    (uint64_t)stat.f_blocks>UINT64_MAX/(uint64_t)stat.f_frsize){e=-EOVERFLOW;goto cleanup;}
 r->filesystem_bytes=(uint64_t)stat.f_frsize*stat.f_blocks;
 if(r->filesystem_bytes>r->card_bytes){e=-EOVERFLOW;goto cleanup;}
 r->free_bytes=(uint64_t)stat.f_frsize*stat.f_bfree;
 r->free_space_available=true;
 }
 if(stop && (e=stop(context)))goto cleanup;
 e=fs_opendir(&directory,"/SD:");
 if(e)goto cleanup;
 opened=true;
 for(unsigned i=0;i<=32;i++){
  if(stop && (e=stop(context)))break;
  struct fs_dirent entry={0};e=fs_readdir(&directory,&entry);
  if(e || !entry.name[0])break;
  if(i==32){r->truncated=true;break;}
  r->entries++;
  if(entry.type==FS_DIR_ENTRY_DIR)r->directories++;
  else if(entry.type==FS_DIR_ENTRY_FILE)r->files++;
 }
 if(!e && stop)e=stop(context);
cleanup:
 if(opened){r->close_error=fs_closedir(&directory);if(!e)e=r->close_error;}
 r->unmount_error=fs_unmount(&mountpoint);if(!e)e=r->unmount_error;
 r->error=e;return e;
}
int p4_sd_readonly_probe(struct p4_sd_probe_result *r)
{return p4_sd_readonly_probe_controlled(r,NULL,NULL);}
```

## src/probe.h
```c
/* SPDX-License-Identifier: MIT */
#ifndef P4_SD_READONLY_PROBE_H
#define P4_SD_READONLY_PROBE_H
#include <stdbool.h>
#include <stdint.h>
struct p4_sd_probe_result {
 uint64_t card_bytes,filesystem_bytes,free_bytes;
 unsigned entries,files,directories;
 unsigned filesystem_type;
 int error,free_space_error,close_error,unmount_error;
 bool free_space_available,truncated;
};
/* Single owner only. No recursive traversal or file-content access. */
int p4_sd_readonly_probe(struct p4_sd_probe_result *result);
/* stop returns 0, -ECANCELED or -ETIMEDOUT. Checked between blocking calls;
 * cleanup is always attempted. It is not a forced interruption of DMA. */
int p4_sd_readonly_probe_controlled(struct p4_sd_probe_result *result,
                                  int (*stop)(void *), void *context);
#endif
```
